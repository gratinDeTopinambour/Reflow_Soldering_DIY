/*
 * NTC_thermistor.c
 *
 *  Created on: 10 févr. 2026
 *      Author: valentin
 */

#include <NTC_thermistor.h>

const int R_serie = 1799; //resistor in serie with thermistor in ohm

//thermistor value in ohm from datasheet
const uint32_t thermistor_ohm_n40_40_LUT [] =
{
		3208260, //-40°C
		3006060,
		2817910,
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		53310, //40°C
};

const uint16_t thermistor_ohm_41_230_LUT [] =
{
		51210, //41°C
		49200,
		47280,
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		257, //230°C
};

const uint8_t thermistor_ohm_231_300_LUT [] =
{
		252, //231°C
		247,
		242,
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		72,//300°C
};


static uint32_t NTC_Rth_Value(uint16_t dig_value)
{
	if(dig_value == 0) return 3208260;
	float Rth = R_serie*(4096.0/((float)dig_value) - 1.0);
	return (uint32_t)Rth;
}

int NTC_Read_Value(ADC_HandleTypeDef *Rth_ADC)
{
	uint16_t adc_value;
	uint32_t Rth_value;
	HAL_ADC_Start(Rth_ADC);
	HAL_ADC_PollForConversion(Rth_ADC, 10);
	adc_value = HAL_ADC_GetValue(Rth_ADC);
	Rth_value = NTC_Rth_Value(adc_value);

	HAL_ADC_Stop(Rth_ADC);

	if(Rth_value < 255)
	{
		for(uint8_t i = 0; i < 70; i++)
		{
			if(Rth_value >= thermistor_ohm_231_300_LUT[i])
			{
				return (int)(i + 231);
			}
		}
		return 300;
	}
	else if(Rth_value < 53310)
	{
		for(uint8_t i = 0; i < 190; i++)
		{
			if(Rth_value >= thermistor_ohm_41_230_LUT[i])
			{
				return (int)(i + 41);
			}
		}
		return 230;
	}
	else
	{
		for(uint8_t i = 0; i < 81; i++)
		{
			if(Rth_value >= thermistor_ohm_n40_40_LUT[i])
			{
				return (int)(i - 40);
			}
		}
		return 40;
	}

}
